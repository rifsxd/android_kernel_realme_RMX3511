/*LWM 1K*/
/ {
    fragment {
            target-path = "/";
            __overlay__ {

            bat: battery {
                compatible = "simple-battery";
                brand = "oplus-lwn-4V45-5000mAh";
                charge-full-design-microamp-hours = <4890000>;
                charge-term-current-microamp = <120000>;
                constant-charge-voltage-max-microvolt = <4435000>;
                factory-internal-resistance-micro-ohms = <110000>;
                voltage-min-design-microvolt = <3455000>;
                ocv-capacity-celsius = <20>;
		fullbatt-voltage = <4395000>;
		fullbatt-current = <240000>;
		fullbatt-track-end-vol = <4390000>;
		fullbatt-track-end-cur = <260000>;
		/*first-calib-voltage = <3600000>;
		first-calib-capacity = <40>;*/
		ocv-capacity-table-0 = <4406000 100>, <4333000 95>, <4272000 90>,
					<4211000 85>, <4151000 80>, <4095000 75>,
					<4043000 70>, <3996000 65>, <3953000 60>,
					<3906000 55>, <3857000 50>, <3830000 45>,
					<3810000 40>, <3793000 35>, <3781000 30>,
					<3765000 25>, <3745000 20>, <3722000 15>,
					<3690000 10>, <3677000 5>, <3400000 0>;
		voltage-temp-table = <1404000 650>, <1307000 700>, <1203000 750>,
					<1095000 800>, <986000 850>, <878000 900>,
					<775000 950>, <678000 1000>, <590000 1050>,
					<510000 1100>, <440000 1150>, <378000 1200>,
					<324000 1250>, <278000 1300>, <238000 1350>,
					<204000 1400>, <175000 1450>, <150000 1500>,
					<129000 1550>, <111000 1600>, <96000 1650>,
					<83000 1700>, <73000 1750>, <63000 1800>,
					<55000 1850>, <48000 1900>, <42000 1950>;
		capacity-temp-table = <45 99>, <25 100>, <18 100>, <12 99>, <10 94>, <0 87>, <(-10) 78>, <(-20) 72>;
		dischg-capacity-temp-table = <45 99>, <25 97 >, <18 94>, <12 94>, <10 94>, <0 90>, <(-10) 78>, <(-20) 72>;
		resistance-temp-table = <45 85>, <25 100>, <10 168>, <0 1045>, <(-10) 1118>, <(-20) 1255>;
		charge-sdp-current-microamp = <500000 500000>;
		charge-dcp-current-microamp = <2000000 2100000>;
		charge-cdp-current-microamp = <1500000 1500000>;
		charge-unknown-current-microamp = <2000000 2000000>;
		dcp-jeita-temp-table = <900 901 0 4435000 0 4435000>,
							<1000 1030 900000 4435000 600000 4180000>,
							<1050 1080 2000000 4435000 1000000 4180000>,
							<1120 1150 2000000 4435000 2000000 4435000>,
							<1160 1190 2200000 4435000 2000000 4180000>,
							<1420 1410 2200000 4435000 2200000 4435000>,
							<1430 1425 1700000 4435000 1700000 4435000>,
							<1440 1435 1500000 4435000 1500000 4435000>,
							<1450 1445 1300000 4435000 1300000 4435000>,
							<1530 1500 1100000 4130000 1100000 4130000>;
		sdp-jeita-temp-table = <900 901 0 4435000 0 4435000>,
							<1000 1030 900000 4435000 600000 4180000>,
							<1050 1080 2000000 4435000 1000000 4180000>,
							<1120 1150 2000000 4435000 2000000 4435000>,
							<1160 1190 2200000 4435000 2000000 4180000>,
							<1420 1410 2200000 4435000 2200000 4435000>,
							<1430 1425 1700000 4435000 1700000 4435000>,
							<1440 1435 1500000 4435000 1500000 4435000>,
							<1450 1445 1300000 4435000 1300000 4435000>,
							<1530 1500 1100000 4130000 1100000 4130000>;
		cdp-jeita-temp-table = <900 901 0 4435000 0 4435000>,
							<1000 1030 900000 4435000 600000 4180000>,
							<1050 1080 2000000 4435000 1000000 4180000>,
							<1120 1150 2000000 4435000 2000000 4435000>,
							<1160 1190 2200000 4435000 2000000 4180000>,
							<1420 1410 2200000 4435000 2200000 4435000>,
							<1430 1425 1700000 4435000 1700000 4435000>,
							<1440 1435 1500000 4435000 1500000 4435000>,
							<1450 1445 1300000 4435000 1300000 4435000>,
							<1530 1500 1100000 4130000 1100000 4130000>;
		unknown-jeita-temp-table = <900 901 0 4435000 0 4180000>,
							<1000 1030 500000 4435000 500000 4180000>,
							<1050 1080 500000 4435000 500000 4180000>,
							<1120 1150 1000000 4435000 1000000 4435000>,
							<1160 1190 1200000 4435000 1200000 4435000>,
							<1420 1410 1200000 4435000 1200000 4435000>,
							<1430 1425 1200000 4435000 1200000 4435000>,
							<1440 1435 1200000 4435000 1200000 4435000>,							
							<1450 1445 1200000 4435000 1200000 4435000>,
							<1530 1500 1000000 4130000 1000000 4130000>;
		};
        };
    };
};
