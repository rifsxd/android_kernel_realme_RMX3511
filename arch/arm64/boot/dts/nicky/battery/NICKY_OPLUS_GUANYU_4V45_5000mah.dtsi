/*LWM 10K*/
/ {
	fragment {
			target-path = "/";
			__overlay__ {

			bat1: battery1 {
				compatible = "simple-battery";
				charge-full-design-microamp-hours = <4868000>;
				charge-term-current-microamp = <120000>;
				constant-charge-voltage-max-microvolt = <4435000>;
				factory-internal-resistance-micro-ohms = <118000>;
				voltage-min-design-microvolt = <3456000>;
				ocv-capacity-celsius = <20>;
				fast-charge-threshold-microvolt = <4200000>;
				
				fullbatt-voltage = <4400000>;
				fullbatt-current = <260000>;
				//fullbatt-track-end-vol = <4295000>;
				//fullbatt-track-end-cur = <130000>;
				first-calib-voltage = <3580000>;
				first-calib-capacity = <50>;

				//ir-cv-offset-microvolt = <100000>;
				//ir-rc-micro-ohms = <20000>;
				//ir-us-upper-limit-microvolt = <4500000>;
				
				ocv-capacity-table-0 = <4413000 100>, <4352000 95>, <4295000 90>,
							<4235000 85>, <4176000 80>, <4118000 75>,
							<4065000 70>, <4016000 65>, <3968000 60>,
							<3914000 55>, <3870000 50>, <3842000 45>,
							<3820000 40>, <3802000 35>, <3786000 30>,
							<3767000 25>, <3747000 20>, <3723000 15>,
							<3692000 10>, <3681000 5>, <3400000 0>;
				voltage-temp-table = <1000097 650>, <954328 700>, <903668 750>,
							<849122 800>, <792187 850>, <734249 900>,
							<676614 950>, <620986 1000>, <568639 1050>,
							<520143 1100>, <475938 1150>, <436313 1200>,
							<401216 1250>, <370308 1300>, <343425 1350>,
							<320171 1400>, <300068 1450>, <282780 1500>,
							<267953 1550>, <255247 1600>, <244533 1650>,
							<235371 1700>, <227491 1750>, <220732 1800>,
							<214944 1850>, <209966 1900>, <205642 1950>;
				capacity-temp-table = <45 99>, <25 100>, <10 100>, <0 94>, <(-10) 86>, <(-20) 72>;
				resistance-temp-table = <45 97>, <25 100>, <10 163>, <0 978>, <(-10) 1086>, <(-20) 1191>;
				charge-sdp-current-microamp = <500000 600000>;
				charge-dcp-current-microamp = <2100000 2400000>;
				charge-cdp-current-microamp = <1500000 1600000>;
				charge-unknown-current-microamp = <2100000 2400000>;
				charge-fchg-current-microamp = <3250000 3300000>; /*1700 1000*/
				dcp-jeita-temp-table = <900 920 0 4435000 0 4180000>,
					<980 1000 1000000 4435000 750000 4180000>,
					<1030 1050 2100000 4435000 1140000 4180000>,
					<1100 1120 2100000 4435000 2100000 4435000>,
					<1140 1160 2100000 4435000 2100000 4435000>,
					<1450 1430 2100000 4435000 2100000 4435000>,
					<1530 1510 1140000 4130000 1140000 4130000>;
				sdp-jeita-temp-table = <900 920 0 4435000 0 4180000>,
					<980 1000 600000 4435000 600000 4435000>,
					<1030 1050 600000 4435000 600000 4435000>,
					<1100 1120 600000 4435000 600000 4435000>,
					<1140 1160 600000 4435000 600000 4435000>,
					<1450 1430 600000 4435000 600000 4435000>,
					<1530 1510 600000 4130000 600000 4130000>;
				cdp-jeita-temp-table = <900 920 0 4435000 0 4180000>,
					<980 1000 1000000 4435000 750000 4180000>,
					<1030 1050 1500000 4435000 1140000 4180000>,
					<1100 1120 1500000 4435000 1500000 4435000>,
					<1140 1160 1500000 4435000 1500000 4435000>,
					<1450 1430 1500000 4435000 1500000 4435000>,
					<1530 1510 1140000 4130000 1140000 4130000>;
				unknown-jeita-temp-table = <900 920 0 4435000 0 4180000>,
					<980 1000 1000000 4435000 750000 4180000>,
					<1030 1050 2100000 4435000 1140000 4180000>,
					<1100 1120 2100000 4435000 2100000 4435000>,
					<1140 1160 2100000 4435000 2100000 4435000>,
					<1450 1430 2100000 4435000 2100000 4435000>,
					<1530 1510 1140000 4130000 1140000 4130000>;
				fchg-jeita-temp-table =<900 920 0 4435000 0 4180000>,
					<980 1000 1000000 4435000 750000 4180000>,
					<1030 1050 2100000 4435000 1140000 4180000>,
					<1100 1120 2100000 4435000 2100000 4435000>,
					<1140 1160 3250000 4435000 2100000 4180000>,
					<1450 1430 3250000 4435000 3250000 4435000>,
					<1530 1510 1140000 4130000 1140000 4130000>;
			};
		};
	};
};
