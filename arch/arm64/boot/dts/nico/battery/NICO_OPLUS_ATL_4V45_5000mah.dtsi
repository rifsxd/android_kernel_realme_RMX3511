/*ATL 10K*/
/ {
	fragment {
			target-path = "/";
			__overlay__ {

			bat: battery {
				compatible = "simple-battery";
				charge-full-design-microamp-hours = <4997000>;
				charge-term-current-microamp = <120000>;
				constant-charge-voltage-max-microvolt = <4435000>;
				factory-internal-resistance-micro-ohms = <110000>;
				voltage-min-design-microvolt = <3455000>;
				ocv-capacity-celsius = <20>;
				
				fullbatt-voltage = <4395000>;
				fullbatt-current = <260000>;

				first-calib-voltage = <3580000>;
				first-calib-capacity = <50>;


				ocv-capacity-table-0 = <4406000 100>, <4333000 95>, <4272000 90>,
							<4211000 85>, <4151000 80>, <4095000 75>,
							<4043000 70>, <3996000 65>, <3953000 60>,
							<3906000 55>, <3857000 50>, <3830000 45>,
							<3810000 40>, <3793000 35>, <3781000 30>,
							<3765000 25>, <3745000 20>, <3722000 15>,
							<3690000 10>, <3677000 5>, <3400000 0>;
				voltage-temp-table = <1000097 650>, <954328 700>, <903668 750>,
							<849122 800>, <792187 850>, <734249 900>,
							<676614 950>, <620986 1000>, <568639 1050>,
							<520143 1100>, <475938 1150>, <436313 1200>,
							<401216 1250>, <370308 1300>, <343425 1350>,
							<320171 1400>, <300068 1450>, <282780 1500>,
							<267953 1550>, <255247 1600>, <244533 1650>,
							<235371 1700>, <227491 1750>, <220732 1800>,
							<214944 1850>, <209966 1900>, <205642 1950>;
				capacity-temp-table = <45 99>, <25 100>, <10 99>, <0 91>, <(-10) 87>, <(-20) 72>;
				resistance-temp-table = <45 85>, <25 100>, <10 168>, <0 1045>, <(-10) 1118>, <(-20) 1255>;
				charge-sdp-current-microamp = <500000 600000>;
				charge-dcp-current-microamp = <2100000 2400000>;
				charge-cdp-current-microamp = <1500000 1600000>;
				charge-unknown-current-microamp = <2100000 2300000>;
				charge-fchg-current-microamp = <3250000 3300000>; /*1700 1000*/
				dcp-jeita-temp-table = <900 920 0 4435000 0 4180000>,
					<980 1000 1000000 4435000 750000 4180000>,
					<1030 1050 2100000 4435000 1140000 4180000>,
					<1100 1120 2100000 4435000 2100000 4435000>,
					<1140 1160 2100000 4435000 2100000 4435000>,
					<1450 1430 2100000 4435000 2100000 4435000>,
					<1530 1510 1140000 4130000 1140000 4130000>;
				sdp-jeita-temp-table = <900 920 0 4435000 0 4180000>,
					<980 1000 500000 4435000 500000 4435000>,
					<1030 1050 500000 4435000 500000 4435000>,
					<1100 1120 500000 4435000 500000 4435000>,
					<1140 1160 500000 4435000 500000 4435000>,
					<1450 1430 500000 4435000 500000 4435000>,
					<1530 1510 500000 4130000 500000 4130000>;
				cdp-jeita-temp-table = <900 920 0 4435000 0 4180000>,
					<980 1000 1000000 4435000 750000 4180000>,
					<1030 1050 1500000 4435000 1140000 4180000>,
					<1100 1120 1500000 4435000 1500000 4435000>,
					<1140 1160 1500000 4435000 1500000 4435000>,
					<1450 1430 1500000 4435000 1500000 4435000>,
					<1530 1510 1140000 4130000 1140000 4130000>;
				unknown-jeita-temp-table = <900 920 0 4435000 0 4180000>,
					<980 1000 1000000 4435000 750000 4180000>,
					<1030 1050 2100000 4435000 1140000 4180000>,
					<1100 1120 2100000 4435000 2100000 4435000>,
					<1140 1160 2100000 4435000 2100000 4435000>,
					<1450 1430 2100000 4435000 2100000 4435000>,
					<1530 1510 1140000 4130000 1140000 4130000>;
				fchg-jeita-temp-table =<900 920 0 4435000 0 4180000>,
					<980 1000 1000000 4435000 750000 4180000>,
					<1030 1050 2100000 4435000 1140000 4180000>,
					<1100 1120 2100000 4435000 2100000 4435000>,
					<1140 1160 3250000 4435000 2100000 4180000>,
					<1450 1430 3250000 4435000 3250000 4435000>,
					<1530 1510 1140000 4130000 1140000 4130000>;
			};
		};
	};
};
