## drivers/gpu/drm/sprd/oppo_display_private_api/Kconfig
```kconfig
config DRM_SPRD_OPPO_DISPLAY_PRIVATE_API
	bool CONFIG_DRM_SPRD_OPPO_DISPLAY_PRIVATE_API
		help
			CONFIG_DRM_SPRD_OPPO_DISPLAY_PRIVATE_API
```

## drivers/input/lcd_bias/Kconfig
```kconfig
#
# Touchscreen driver configuration
#
config LCM_BIAS_VOLTAGE_ON
        tristate "bias voltage of lcm"
        depends on I2C
        help
          Turn on this config.the bias of lcm will setting when turn on screen.

          If unsure, say N.
```

## drivers/input/touchscreen/ICNL9911/Kconfig
```kconfig
config TOUCHSCREEN_CTS
    tristate "Cts Touchscreen"
    help
      Say Y here if you have CTS touch panel.
      If unsure, say N.
      

    
```

## drivers/input/touchscreen/chipone-tddi/Kconfig
```kconfig
config TOUCHSCREEN_CHIPONE
	tristate "chipone-tddi Touchscreen Driver"
	help
	  Say Y here if you have a chipone-tddi Touchscreen.

	  If unsure, say N.
```

## drivers/input/touchscreen/focaltech_touch_milan/Kconfig
```kconfig
#
# Focaltech Touchscreen driver configuration
#

config TOUCHSCREEN_FTS
    tristate "Focaltech Touchscreen"
    default n
    depends on TOUCHSCREEN_FTS_CHIPSET
    help
      Say Y here if you have Focaltech touch panel.
      If unsure, say N.
      
config TOUCHSCREEN_FTS_DIRECTORY
    tristate "Focaltech ts directory name"
    default "focaltech_touch"
    depends on TOUCHSCREEN_FTS
    
```

## drivers/input/touchscreen/ili9882q/Kconfig
```kconfig
#
# ili9881 driver
#
config TOUCHSCREEN_ILI9882N
	tristate "ili9882n Touchscreen Driver"
	help
	  Say Y here if you have a ili9882n Touchscreen.

	  If unsure, say N.
```

## drivers/misc/device_info/Kconfig
```kconfig
config OPLUS_DEVICE_IFNO
	tristate "config oplus factory mode device info software"
	help
		define this config to compile device_info.c for device register
```

## drivers/misc/hqhardwareinfo/Kconfig
```kconfig
config HQ_HARDWARE_INFO
	tristate "hardware info"
	help
		define this config to compile hardware_info.c for device register
```

## drivers/soc/oppo/Kconfig
```kconfig
#ifdef VENDOR_EDIT
config OPPO_DEVICE_IFNO
        bool "config oppo devinfo"
        select OPPO_ARCH_FILE
        help
        define this config to compile devinfo.c for device register.

source "drivers/soc/oppo/oppo_devinfo/Kconfig"

#endif
```

## drivers/unisoc_platform/audio/sprd/codec/sprd/sia81xx/Kconfig
```kconfig
config SND_SOC_UNISOC_CODEC_SIA81XX
	tristate "SoC Audio for SIA81XX PA"
	help
	  This option enables support for SIA81XX PA.
```
